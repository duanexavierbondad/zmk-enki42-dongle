## config/west.yml
```yaml
manifest:
  remotes:
    - name: caksoylar
      url-base: https://github.com/duanexavierbondad
  projects:
    - name: zmk
      remote: caksoylar
      revision: caksoylar/experimental
      import: app/west.yml
    - name: zmk-tri-state
      remote: caksoylar
      revision: main
  self:
    path: config
```
